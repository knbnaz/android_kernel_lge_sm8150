## drivers/mmc/Kconfig
```kconfig
# SPDX-License-Identifier: GPL-2.0-only
#
# MMC subsystem configuration
#

menuconfig MMC
	tristate "MMC/SD/SDIO card support"
	depends on HAS_IOMEM
	help
	  This selects MultiMediaCard, Secure Digital and Secure
	  Digital I/O support.

	  If you want MMC/SD/SDIO support, you should say Y here and
	  also to your specific host controller driver.

config LGE_MMC_CLK_SCALE_DISABLE
	bool "disable clock scaling for mmc"
	default y
	help
	  If you say Y here, clock scaling for mmc device will be disabled.
	  Set Y in kernel/arch/arm/configs/XXXX_defconfig file.

config LGE_TRAY_EVENT
    bool "Show SD Card Detect pin status"
    depends on MACH_LGE
    default y
    help
        Support the uevent for SD Card TRAY status.

config LGE_ENABLE_MMC_CAP_SD_WAKE
    bool "enable interrupt during sleep status"
    default y
    help
        If you say Y here, SD Card interrupt pin is interruptable in sleep status.

if MMC

source "drivers/mmc/core/Kconfig"

source "drivers/mmc/host/Kconfig"

endif # MMC
```

## drivers/power/supply/lge/Kconfig
```kconfig
config LGE_PM_VENEER_PSY
	bool "Apply LGE veneer psy"
	depends on LGE_PM
	default n
	help
	  Say Y here enable support lge veneer psy

config LGE_PM_CCD
	bool "support Charging Control Daemon"
	depends on LGE_PM
	default n
	help
	  Say Y to using Charging Control Daemon(CCD)

config LGE_PM_BRINGUP
	bool "support LGE PM Bringup"
	depends on LGE_PM
	default n
	help
	  Say Y to using LGE PM Bringup

config LGE_PM_ACTM
	bool "support LGE PM ACTM"
	depends on LGE_PM
	default n
	help
	  Say Y to using LGE PM ACTM (MASSFIVEG-1578)

config LGE_PM_ACTM_V2
	bool "LGE Adaptive Charging Thermal Mitigation Engine V2 - minor update"
	depends on LGE_PM
	default n
	help
	  Say Y here enable support lge actm

config LGE_PM_EXT_QG_V2
	bool "LGE extension-qg-v2"
	depends on LGE_PM
	default n
	help
	  Say Y here

config LGE_PM_PROT_BATVOLT_V2
	bool "Apply LGE protection batvolt alg v2"
	depends on LGE_PM
	default n
	help
	  Say Y here enable support LGE protection batvolt alg v2
```

## drivers/thermal/lge/Kconfig
```kconfig
config LGE_PM_VIRTUAL_SENSOR
	bool "LGE Virtual Sensor driver"
	depends on THERMAL_OF
	help
	  This driver has the information about the virtual sensors and 
	  registers the virtual sensors to a thermal zone.
	  The virtual sensor information includes the underlying thermal
	  sensors to query for temperature and the aggregation logic to
	  determine the virtual sensor temperature.
```

## drivers/tspdrv/Kconfig
```kconfig
#
# tspdrv subsystem configuration
#

menu "Tspdrv support"

config TSPDRV
	tristate "TouchSense driver support"
	default n

source "drivers/tspdrv/dw7800/Kconfig"
source "drivers/tspdrv/a2v/Kconfig"

endmenu
```
