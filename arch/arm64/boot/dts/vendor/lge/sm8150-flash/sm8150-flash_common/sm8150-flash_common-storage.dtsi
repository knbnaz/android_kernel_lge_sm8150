/*
 * Copyright (c) 2018, The Linux Foundation. All rights reserved.
 *
 * This program is free software; you can redistribute it and/or modify
 * it under the terms of the GNU General Public License version 2 and
 * only version 2 as published by the Free Software Foundation.
 *
 * This program is distributed in the hope that it will be useful,
 * but WITHOUT ANY WARRANTY; without even the implied warranty of
 * MERCHANTABILITY or FITNESS FOR A PARTICULAR PURPOSE.  See the
 * GNU General Public License for more details.
 */
#include "../../sm8150_common/sm8150_common-storage.dtsi"

&sdc2_on {
	sd-cd {
		pins = "gpio48";
		bias-pull-up;           /* pull up */
		drive-strength = <2>;   /* 2 MA */
	};
};

&sdhc_2 {
	cd-gpios = <&tlmm 48 GPIO_ACTIVE_HIGH>;
};
