/*
 * Copyright (c) 2018, The Linux Foundation. All rights reserved.
 *
 * This program is free software; you can redistribute it and/or modify
 * it under the terms of the GNU General Public License version 2 and
 * only version 2 as published by the Free Software Foundation.
 *
 * This program is distributed in the hope that it will be useful,
 * but WITHOUT ANY WARRANTY; without even the implied warranty of
 * MERCHANTABILITY or FITNESS FOR A PARTICULAR PURPOSE.  See the
 * GNU General Public License for more details.
 */

#include "../../sm8150_common/sm8150_common-fingerprint.dtsi"

&soc {
	/* L7C pm8150l_l7 */
	rpmh-regulator-ldoc7 {
		regulator-pm8150l-l7 {
			regulator-min-microvolt = <2856000>;
			regulator-max-microvolt = <3300000>;
			qcom,init-voltage = <3000000>;
			regulator-always-on;
		};
	};

	fingerprint@0 {
		status = "ok";
    		compatible = "goodix,fingerprint";

		interrupt-parent = <&tlmm>;
		interrupts = <118>;

		goodix,gpio_irq = <&tlmm 118 0x00>;
		goodix,gpio_reset = <&tlmm 116 0x00>;
		goodix,gpio_cs  = <&tlmm 101 0x00>;
		goodix,vddio-supply = <&pm8150l_l7>;
		gf,vddio-uV = <3000000>;
	};
};
