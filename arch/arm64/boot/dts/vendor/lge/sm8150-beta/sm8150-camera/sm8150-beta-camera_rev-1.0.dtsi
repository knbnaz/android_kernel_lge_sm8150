/*
 * Copyright (c) 2018, The Linux Foundation. All rights reserved.
 *
 * This program is free software; you can redistribute it and/or modify
 * it under the terms of the GNU General Public License version 2 and
 * only version 2 as published by the Free Software Foundation.
 *
 * This program is distributed in the hope that it will be useful,
 * but WITHOUT ANY WARRANTY; without even the implied warranty of
 * MERCHANTABILITY or FITNESS FOR A PARTICULAR PURPOSE.  See the
 * GNU General Public License for more details.
 */

#include "sm8150-beta-camera_common.dtsi"

&soc {
	#address-cells = <1>;
	#size-cells = <1>;

	camera_rear_t_afvdd_ldo: gpio-regulator@a {
		compatible = "regulator-fixed";
		reg = <0x0a 0x00>;
		regulator-name = "camera_rear_t_afvdd_ldo";
		regulator-min-microvolt = <3000000>;
		regulator-max-microvolt = <3000000>;
		regulator-enable-ramp-delay = <135>;
		enable-active-high;
		gpio = <&tlmm 165 0>;
		pinctrl-names = "default";
		pinctrl-0 = <&cam_sensor_rear_t_afvdd>;
		vin-supply = <&pm8150l_bob>;
	};
};
