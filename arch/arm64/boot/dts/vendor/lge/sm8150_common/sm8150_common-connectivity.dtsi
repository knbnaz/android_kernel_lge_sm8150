// SPDX-License-Identifier: GPL-2.0

&vendor {
	bluetooth: bt_wcn3990 {
		compatible = "qcom,wcn3990";
		qcom,bt-sw-ctrl-gpio = <&tlmm 69 GPIO_ACTIVE_HIGH>;
		qcom,bt-vdd-io-supply = <&L11A>;  /* IO */
		qcom,bt-vdd-core-supply = <&L2E>; /* RFA */
		qcom,bt-vdd-pa-supply = <&L10E>; /* CH0 */
		qcom,bt-vdd-xtal-supply = <&L7A>; /* XO */

		qcom,bt-vdd-io-config = <1700000 1900000 1 0>;
		qcom,bt-vdd-core-config = <1304000 1304000 1 0>;
		qcom,bt-vdd-pa-config = <3000000 3312000 1 0>;
		qcom,bt-vdd-xtal-config = <1700000 1900000 1 0>;
	};
};
